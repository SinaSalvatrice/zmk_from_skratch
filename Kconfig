## dts/bindings/display/solomon,ssd1306fb.yaml
```yaml
description: Solomon SSD1306 128x64 OLED display driver

compatible: "solomon,ssd1306fb"

include: [display-controller.yaml, i2c-device.yaml]

properties:
  width:
    type: int
    description: Display width in pixels

  height:
    type: int
    description: Display height in pixels

  segment-offset:
    type: int
    default: 0
    description: Segment remap offset

  page-offset:
    type: int
    default: 0
    description: Page offset

  display-offset:
    type: int
    default: 0
    description: Display start line offset

  multiplex-ratio:
    type: int
    default: 63
    description: Multiplex ratio

  master-current:
    type: int
    default: 0x0f
    description: Master current control

  invert-colors:
    type: boolean
    description: Invert display colors
```
