#include <dt-bindings/zmk/matrix.h>

/ {
	chosen {
		zmk,display = &oled;
	};
};

&i2c0 {
	status = "okay";

	oled: ssd1306@3c {
		compatible = "solomon,ssd1306fb";
		reg = <0x3c>;
		width = <128>;
		height = <64>;
		segment-offset = <0>;
		page-offset = <0>;
		display-offset = <0>;
		multiplex-ratio = <63>;
		master-current = <0x0f>;
		invert-colors;
	};
};
